## conf/machine/linkit7688.conf
```bitbake
#@TYPE: Machine
#@NAME: linkit7688

#@DESCRIPTION: Machine configuration for linkit7688 systems

require conf/machine/include/mips/tune-mips-24k.inc
DEFAULTTUNE = "mips32r2-24kec"

MACHINE_FEATURES = "usbhost serial wifi"

KERNEL_IMAGETYPE = "vmlinux"
KERNEL_ALT_IMAGETYPE = "vmlinux.bin"
KERNEL_IMAGE_STRIP_EXTRA_SECTIONS  = ".comment"

PREFERRED_PROVIDER_virtual/kernel="linux-yocto-linkit7688-4.14.95"
PREFERRED_VERSION_linux-yocto-linkit7688 ?= "4.14%"

SERIAL_CONSOLE = "57600 ttyS2"
USE_VT ?= "0"

MACHINE_EXTRA_RRECOMMENDS = " kernel-modules"
DISTRO_FEATURES_append += " sysvinit wifi ipv4"

IMAGE_ROOTFS_MAXSIZE="51000"
IMAGE_FSTYPES ?= "jffs2 tar.bz2"
JFFS2_ERASEBLOCK = "0x10000"

MACHINE_ESSENTIAL_EXTRA_RRECOMMENDS += "\
kernel-module-backports \
kernel-module-mt76 \
kernel-module-mt7603e \
kernel-module-mt76x2e \
"
# Port for 4.14.95
# kernel-module-gpio-button-hotplug

KERNEL_MODULE_AUTOLOAD += "\
mt76 \
mt7603e \
mt76x2e \
"

# Port for 4.14.95
# gpio-button-hotplug

RDEPENDS_kernel-base = ""

# Little Endian
TUNE_FEATURES_tune-mips-nf = "o32"

TARGET_CFLAGS += " -pipe -mno-branch-likely -fno-caller-saves -minterlink-mips16 -fno-stack-protector "
TARGET_CXXFLAGS += " -pipe -mno-branch-likely -fno-caller-saves -minterlink-mips16 -fno-stack-protector "
```
